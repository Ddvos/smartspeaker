## lampje-microcontroller/sdkconfig.defaults
```kconfig
# Target: ESP32-P4
CONFIG_IDF_TARGET="esp32p4"

# Flash size (32MB on Waveshare board)
CONFIG_ESPTOOLPY_FLASHSIZE_32MB=y

# WiFi via ESP32-C6 companion chip
CONFIG_ESP_WIFI_REMOTE_ENABLED=y

# Custom partition table
CONFIG_PARTITION_TABLE_CUSTOM=y
CONFIG_PARTITION_TABLE_CUSTOM_FILENAME="partitions.csv"

# NVS for config storage
CONFIG_NVS_ENCRYPTION=n

# HTTP client
CONFIG_ESP_HTTP_CLIENT_ENABLE_HTTPS=y
CONFIG_HTTPD_MAX_REQ_HDR_LEN=1024

# PSRAM (32MB on Waveshare board)
CONFIG_SPIRAM=y
CONFIG_SPIRAM_MODE_HEX=y

# LVGL
CONFIG_LV_USE_LOG=y
CONFIG_LV_LOG_LEVEL_WARN=y

# Allow HTTP for development (disable in production)
CONFIG_ESP_HTTPS_OTA_ALLOW_HTTP=y
```
